## board/at91kizbox/at91kizboxnf_linux_image_dt_ubi_defconfig
```kconfig
CONFIG_AT91KIZBOX=y
CONFIG_RAM_32MB=y
CONFIG_NANDFLASH=y
# CONFIG_PMECC_AUTO_DETECT is not set
CONFIG_LOAD_LINUX=y
CONFIG_LINUX_ZIMAGE=y
CONFIG_THUMB=y
# CONFIG_DISABLE_WATCHDOG is not set
CONFIG_UBI=y
```

## board/at91kizbox2/at91kizbox2nf_linux_image_dt_ubi_defconfig
```kconfig
CONFIG_AT91KIZBOX2=y
CONFIG_CPU_CLK_528MHZ=y
CONFIG_RAM_256MB=y
CONFIG_NANDFLASH=y
# CONFIG_PMECC_AUTO_DETECT is not set
CONFIG_PMECC_CORRECT_BITS_4=y
CONFIG_LOAD_LINUX=y
CONFIG_LINUX_ZIMAGE=y
# CONFIG_DISABLE_WATCHDOG is not set
# CONFIG_SCLK is not set
CONFIG_ACT8865=y
# CONFIG_DISABLE_ACT8865_I2C is not set
# CONFIG_AUTOCONFIG_TWI_BUS is not set
CONFIG_PMIC_ON_TWI1=y
CONFIG_UBI=y
```

## board/at91kizboxmini/at91kizboxmininf_linux_image_dt_ubi_defconfig
```kconfig
CONFIG_AT91KIZBOXMINI=y
CONFIG_RAM_128MB=y
CONFIG_NANDFLASH=y
CONFIG_PMECC_AUTO_DETECT=y
CONFIG_LOAD_LINUX=y
CONFIG_LINUX_ZIMAGE=y
CONFIG_THUMB=y
# CONFIG_DISABLE_WATCHDOG is not set
# CONFIG_SCLK is not set
CONFIG_UBI=y
```
